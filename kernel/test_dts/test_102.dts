/*
 * Top level DTS file for AGX001.
 */
//#include "common/tegra194-agx-cti-base.dtsi"
/include "tegra194-agx-cti-AGX101.dts"
/include "common/tegra194-p2822-0000-cti-camera-ar0330-a00-8cam.dtsi"
/{
    nvidia,dtsfilename = "tegra194-agx-cti-AGX101-JCB002-AR0330-8CAM.dts";
    nvidia,dtbbuildtime = __DATE__, __TIME__;
};
